## config/west.yml
```yaml
manifest:
  remotes:
    - name: zmkfirmware
      url-base: https://github.com/urob
  projects:
    - name: zmk
      remote: zmkfirmware
      revision: fix-mod-morph
      import: app/west.yml
  self:
    path: config
```
